//Font Creator Website http://tinkering-arduino.de/blog/2014/03/24/font-generator-fur-das-8x8-led-matrix-display/
// Idea taken from https://www.instructables.com/id/48-X-8-Scrolling-LED-Matrix-Using-Arduino/

#define max_char 100 
int blinki=3;
int charIndex;
int scrollspeed = 15; //Set the scroll speed ( lower=faster)
int i;
int x;
int y;
char r_char;

char msg[] =" WELCOME To KBI Ltd.Kigali Bearings Import Ltd.Phone:0788 303 113";//Change the text here.
//char msg[] =" 12:50 am ";//Change the text here.



//Columns
int clockPin1 = 10; //6 Arduino pin connected to Clock Pin 11 of 74HC595
int latchPin1 = 9; //5 Arduino pin connected to Latch Pin 12 of 74HC595
int dataPin1 = 8;  //7 Arduino pin connected to Data Pin 14 of 74HC595

//Rows
int clockPin2 = 6; //10 Arduino pin connected to Clock Pin 11 of 74HC595
int latchPin2 = 5; //9 Arduino pin connected to Latch Pin 12 of 74HC595
int dataPin2 = 7;  //8 Arduino pin connected to Data Pin 14 of 74HC595

//BITMAP
//Bits in this array represents one LED of  the matrice 8 is # of rows, 6 is # of LED matrices
byte bitmap[8][8]; 

int numZones = sizeof(bitmap) / 8; // One Zone refers to one 8 x 8 Matrix ( Gp 8 columns)
int maxZoneIndex = numZones-1;
int numCols = numZones * 8;

char alphabets[95][8] = {
  {0x00,0x00,0x00,0x00,0x00,0x00,0x00,0x00},  //  TAB
  {0x00,0x00,0x00,0x4f,0x4f,0x00,0x00,0x00},  // !
  {0x00,0x07,0x07,0x00,0x00,0x07,0x07,0x00},  // "
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  {0x00,0x08,0x04,0x0c,0x18,0x01,0x08,0x00}   // ~
};


void clearBitmap()
{
 //Clear bitmap
 for (int row = 0; row < 8; row++) {
   for (int zone = 0; zone <= maxZoneIndex; zone++) {
     bitmap[row][zone] = 0; 
   }
 }  
}

void setup() {

 pinMode(latchPin1, OUTPUT);
 pinMode(clockPin1, OUTPUT);
 pinMode(dataPin1, OUTPUT);

 pinMode(latchPin2, OUTPUT);
 pinMode(clockPin2, OUTPUT);
 pinMode(dataPin2, OUTPUT);
 Serial.begin(9600);


 clearBitmap();
}

//FUNCTIONS
// Displays bitmap array in the matrix
void RefreshDisplay()
{
 for (int row = 0; row < 8; row++) {
   int rowbit = 1 << row;
   digitalWrite(latchPin2, LOW);//Hold latchPin LOW for transmitting data
   shiftOut(dataPin2, clockPin2, LSBFIRST, rowbit);   //Transmit data

   //Start sending column bytes
   digitalWrite(latchPin1, LOW);//Hold latchPin LOW for transmitting data

   //Shift out to each matrix
   for (int zone = maxZoneIndex; zone >= 0; zone--) 
   {
     shiftOut(dataPin1, clockPin1, MSBFIRST, bitmap[row][zone]);
   }

   //flip both latches at once to eliminate flicker
   digitalWrite(latchPin1, HIGH);//Return the latch pin 1 high to signal chip
   digitalWrite(latchPin2, HIGH);//Return the latch pin 2 high to signal chip

   //Wait
   delayMicroseconds(300);
 }
}

// Converts row and colum to bitmap bit and turn it off/on
void Plot(int col, int row, bool isOn)
{
 int zone = col / 8;
 int colBitIndex = x % 8;
 byte colBit = 1 << colBitIndex;
 if (isOn)
   bitmap[row][zone] =  bitmap[y][zone] | colBit;
 else
   bitmap[row][zone] =  bitmap[y][zone] & (~colBit);
}

// Plot each character of the message one column at a time, updated the display, shift bitmap left.
void XProcess()
{

 for (charIndex=0; charIndex <(sizeof(msg)-1); charIndex++)
 {
   int alphabetIndex = msg[charIndex] - ' ';                                     
   // I changed '@' to ' ' to display the different alphabets
   if (alphabetIndex < 0) alphabetIndex=0;
   
   //Draw one character of the message Each character is 5 columns wide, loop two more times to create 2 pixel space betwen characters
   for (int col = 0; col < 8; col++)
   {
     for (int row = 0; row < 8; row++)
     {
       // Set the pixel to what the alphabet say for columns 0 thru 4, but always leave columns 5 and 6 blank.
       bool isOn = 0; 
       if (col<8) isOn = bitRead( alphabets[alphabetIndex][col], 7-row ) == 1;
       Plot( numCols-1, row, isOn); //Draw on the rightmost column, the shift loop below will scroll it leftward.
     }
     for (int refreshCount=0; refreshCount < scrollspeed; refreshCount++)
       RefreshDisplay();
     //Shift the bitmap one column to left
     for (int row=0; row<8; row++)
     {
       for (int zone=0; zone < numZones; zone++)
       {
         //This right shift would show as a left scroll on display because leftmost column is represented by least significant bit of the byte.
         bitmap[row][zone] = bitmap[row][zone] >> 1;
         // Shift over lowest bit from the next zone as highest bit of this zone.
         if (zone < maxZoneIndex) bitWrite(bitmap[row][zone], 7, bitRead(bitmap[row][zone+1],0));
       }
     }
   }
 } 
}

void serialInput(){
   //check if serial is avaible an before reading a new message delete's the old message
   if(Serial.available()){       
        for(i=0; i<105; i++){
         msg[i] = '\0';
        } 
        //resests the index        
        charIndex=0;
    }
    //while is reading the message 
    while(Serial.available()){
       //the message can have up to 100 characters 
       if(charIndex < (max_char-1)) 
       {         
           r_char = Serial.read();      // Reads a character
           msg[charIndex] = r_char;     // Stores the character in message array
           charIndex++;                     // Increment position
           msg[charIndex] = '\0';       // Delete the last position
       }
   }  
}

void loop() { 
 XProcess();
 serialInput();

}
